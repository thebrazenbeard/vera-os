## buildroot/Config.in
```kconfig
menu "VeraOS external options"
comment "VeraOS is the operating environment; Buildroot is image-construction tooling."
endmenu
```

## buildroot/configs/veraos_x86_64_browser_defconfig
```kconfig
# VeraOS x86_64 development/qualification image.
# VeraOS browser-capable qualification profile.
# VeraOS is the OS identity; Linux and Buildroot are implementation substrate.

BR2_x86_64=y
BR2_TOOLCHAIN_BUILDROOT_GLIBC=y
BR2_TOOLCHAIN_BUILDROOT_CXX=y
BR2_INIT_NONE=y
BR2_TARGET_GENERIC_HOSTNAME="veraos"
BR2_TARGET_GENERIC_ISSUE="VeraOS private development image"
BR2_ROOTFS_DEVICE_CREATION_DYNAMIC_EUDEV=y

BR2_PACKAGE_BUSYBOX=y
BR2_PACKAGE_PYTHON3=y
BR2_PACKAGE_SQLITE=y
BR2_PACKAGE_CA_CERTIFICATES=y
BR2_PACKAGE_IPROUTE2=y
BR2_PACKAGE_DHCPCD=y
BR2_PACKAGE_EUDEV=y
BR2_PACKAGE_DBUS=y

# Browser-capable image: WPE WebKit + Cog over DRM/KMS.
BR2_PACKAGE_MESA3D=y
BR2_PACKAGE_MESA3D_GALLIUM_DRIVER_SWRAST=y
BR2_PACKAGE_MESA3D_GALLIUM_DRIVER_VIRGL=y
BR2_PACKAGE_MESA3D_OPENGL_EGL=y
BR2_PACKAGE_MESA3D_OPENGL_ES=y
BR2_PACKAGE_WPEWEBKIT=y
BR2_PACKAGE_WPEWEBKIT_SANDBOX=y
BR2_PACKAGE_WPEWEBKIT_WEBDRIVER=y
BR2_PACKAGE_COG=y
BR2_PACKAGE_COG_PLATFORM_DRM=y

BR2_LINUX_KERNEL=y
BR2_LINUX_KERNEL_CUSTOM_VERSION=y
BR2_LINUX_KERNEL_CUSTOM_VERSION_VALUE="6.6.69"
BR2_LINUX_KERNEL_USE_ARCH_DEFAULT_CONFIG=y
BR2_LINUX_KERNEL_NEEDS_HOST_LIBELF=y

BR2_ROOTFS_OVERLAY="$(BR2_EXTERNAL_VERAOS_PATH)/board/veraos/x86_64/rootfs-overlay"
BR2_ROOTFS_POST_BUILD_SCRIPT="$(BR2_EXTERNAL_VERAOS_PATH)/board/veraos/x86_64/post-build.sh"

BR2_TARGET_ROOTFS_EXT2=y
BR2_TARGET_ROOTFS_EXT2_4=y
BR2_TARGET_ROOTFS_EXT2_SIZE="2G"
# BR2_TARGET_ROOTFS_TAR is not set

BR2_PACKAGE_HOST_QEMU=y
BR2_PACKAGE_HOST_QEMU_SYSTEM_MODE=y
```
